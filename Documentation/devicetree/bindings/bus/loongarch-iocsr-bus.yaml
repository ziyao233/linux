## Documentation/devicetree/bindings/bus/loongarch-iocsr-bus.yaml
```yaml
# SPDX-License-Identifier: (GPL-2.0-only OR BSD-2-Clause)
%YAML 1.2
---
$id: http://devicetree.org/schemas/bus/loongarch-iocsr-bus.yaml#
$schema: http://devicetree.org/meta-schemas/core.yaml#

title: IOCSR-based Bus on LoongArch Platforms

maintainers:
  - Yao Zi <ziyao@disroot.org>

description:
  LoongArch platforms may implement IOCSR operation instructions, which access
  an independent byte-addressed address space. This documentation describes the
  binding for the IOCSR-based bus.

properties:
  compatible:
    const: loongarch-iocsr-bus

  '#address-cells':
    const: 2

  '#size-cells':
    const: 2

required:
  - compatible
  - '#address-cells'
  - '#size-cells'

unevaluatedProperties: false

examples:
  - |
    iocsr {
        compatible = "loongarch-iocsr-bus";
        #address-cells = <2>;
        #size-cells = <2>;
    };
```

## Documentation/devicetree/bindings/loongarch/iocsr.yaml
```yaml
# SPDX-License-Identifier: (GPL-2.0-only OR BSD-2-Clause)
%YAML 1.2
---
$id: http://devicetree.org/schemas/loongarch/iocsr.yaml#
$schema: http://devicetree.org/meta-schemas/core.yaml#

title: LoongArch IOCSRs

maintainers:
  - Yao Zi <ziyao@disroot.org>

description:
  Definition of LoongArch IOCSRs depend on the specific platform. This
  document describes known LoongArch IOCSRs that independently serve for a
  dedicated purpose.

properties:
  compatible:
    anyOf:
      - const: loongson,iocsr-vendor
        description:
          The "VENDOR" IOCSR for recording manufacturer of the device, contains
          constant string "Loongson" on known devices. Note that this IOCSR
          is writable and should be set up by firmware.

      - const: loongson,iocsr-cpuname
        description:
          The "CPUNAME" IOCSR for recording production name of the chip. Note
          that this IOCSR is writable and should be set up by firmware.

  reg:
    maxItems: 1

required:
  - compatible
  - reg

additionalProperties: false

examples:
  - |
    iocsr {
        compatible = "loongarch-iocsr-bus";
        #address-cells = <2>;
        #size-cells = <2>;

        vendor@10 {
            compatible = "loongson,iocsr-vendor";
            reg = <0x0 0x10 0x0 0x8>;
        };

        cpuname@20 {
            compatible = "loongson,iocsr-cpuname";
            reg = <0x0 0x20 0x0 0x8>;
        };
    };
```

## Documentation/devicetree/bindings/rng/sophgo,sg2000-trng.yaml
```yaml
# SPDX-License-Identifier: (GPL-2.0-only OR BSD-2-Clause)
%YAML 1.2
---
$id: http://devicetree.org/schemas/rng/sophgo,sg2000-trng.yaml#
$schema: http://devicetree.org/meta-schemas/core.yaml#

title: Sophgo SG2000 TRNG

maintainers:
  - Yao Zi <me@ziyao.cc>

properties:
  compatible:
    const: sophgo,sg2000-trng

  reg:
    maxItems: 1

  clocks:
    maxItems: 1

  interrupts:
    maxItems: 1

required:
  - compatible
  - reg
  - clocks
  - interrupts

additionalProperties: false

examples:
  - |
    rng@2070000 {
        compatible = "sophgo,sg2000-trng";
        reg = <0x02070000 0x10000>;
        clocks = <&clk>;
        interrupts = <42>;
    };
```
